## projects/max30009/Kconfig
```kconfig
menu "max30009 Configuration"

choice MAX30009
	prompt "Example variant"
	default MAX30009_BASIC_EXAMPLE

config MAX30009_BASIC_EXAMPLE
	bool "Basic example"

config MAX30009_IIO_EXAMPLE
	bool "IIO streaming example"

endchoice

endmenu
```
